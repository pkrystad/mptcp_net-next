## net/mptcp/Kconfig
```kconfig
#
# MPTCP configuration
#
config MPTCP
        bool "MPTCP protocol"
        depends on (IPV6=y || IPV6=n)
        ---help---
          This replaces the normal TCP stack with a Multipath TCP stack,
          able to use several paths at once.

config MPTCP_SOCKETS
	bool "MPTCP sockets"
	depends on MPTCP=y
	---help---
	  Support MPTCP protocol sockets.
```
